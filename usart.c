#include <usart.h>

//передающий буфер
RingBuffer_t usartTxBuf;
u08 usartTxData[SIZE_TX_BUF];

//приемный буфер
RingBuffer_t usartRxBuf;
u08 usartRxData[SIZE_RX_BUF];



//инициализация usart`a
void USART_Init(void)
{
    UBRR0L = LO(bauddivider);
    UBRR0H = HI(bauddivider);
    UCSR0A = 0;
    /*      RXC0 -      Флаг завершения приема. Флаг устанавливается в 1 при наличии  
                        непрочитанных данных в буфере приемника (регистр данных UDR). Сбрасывается 
                        флаг аппаратно после опустошения буфера. Если бит RXCIE0  
                        регистра UCSR0B установлен, то при установке флага генерируется 
                        запрос на прерывание «прием завершен» 

            TXC0 -      Флаг завершения передачи. Флаг устанавливается в 1 после передачи всех  
                        битов посылки из сдвигового регистра передатчика при условии, что в регистр 
                        данных UDR не было загружено новое значение. Если бит TXCIE0 
                        регистра UCSR0B установлен, то при установке флага  
                        генерируется прерывание «передача завершена». Флаг сбрасывается аппаратно при  
                        выполнении подпрограммы обработки прерывания или программно, записью 
                        в него лог. 1 

            UDRE0 -     Флаг опустошения регистра данных. Данный флаг устанавливается в 1 
                        при пустом буфере передатчика (после пересылки байта из регистра данных 
                        UDR в сдвиговый регистр передатчика). Установленный флаг означает, 
                        что в регистр данных можно загружать новое значение. Если бит UDRIE 
                        регистра UCSR0B установлен, генерируется запрос на прерывание «регистр 
                        данных пуст». Флаг сбрасывается аппаратно, при записи в регистр данных 
            
            FE0 -       Флаг ошибки кадрирования. Флаг устанавливается в 1 при обнаружении 
                        ошибки кадрирования, т. е. если первый стоп-бит принятой посылки равен 0. 
                        Флаг сбрасывается при приеме стоп-бита, равного 1 
            
            DOR0 -      Флаг переполнения. Флаг устанавливается в 1, если в момент обнаружения 
                        нового старт-бита в сдвиговом регистре приемника находится последнее 
                        принятое слово, а буфер приемника полон (содержит два байта). Флаг  
                        сбрасывается при пересылке принятых данных из сдвигового регистра  
                        приемника в буфер. 
            
            UPE0 -      Флаг ошибки контроля четности. Флаг устанавливается в 1, если в данных, 
                        находящихся в буфере приемника, выявлена ошибка контроля четности. 
                        При отключенном контроле четности этот бит постоянно сброшен в 0 
            
            U2X0 -      Удвоение скорости обмена. Если этот бит установлен в 1, то коэффициент 
                        деления предделителя контроллера скорости передачи уменьшается с 16 до 
                        8, удваивая тем самым скорость асинхронного обмена по  последовательному
                        каналу. Этот бит используется только при асинхронном режиме работы 
                        и в синхронном режиме должен быть сброшен 
            
            MPCM0 -     Режим мультипроцессорного обмена. Если этот бит установлен в 1, ведомый 
                        микроконтроллер ожидает приема кадра, содержащего адрес. Кадры, 
                        не содержащие адреса устройства, игнорируются */

    UCSR0B = 1<<RXEN0|1<<TXEN0|1<<RXCIE0|0<<TXCIE0;
    /*      RXCIE -     Разрешение прерывания по завершении приема. Если данный бит установлен 
                        в 1, то при установке флага RXC0 регистра UCSR0A  генерируется прерывание 
                        «прием завершен» (если флаг I регистра SREG установлен в1) 

            TXCIE -     Разрешение прерывания по завершении передачи. Если данный бит установлен 
                        в 1, то при установке флага TXC регистра UCSRA генерируется прерывание 
                        «передача завершена» (если флаг 1 регистра SREG  установлен в 1) 

            UDRIE -     Разрешение прерывания при очистке регистра данных UART. Если данный бит 
                        установлен в 1, то при установке флага UDRE  регистра UCSRA 
                        генерируется прерывание «регистр данных пуст» (если флаг I  
                        регистра SREG установлен в 1) 

            RXEN  -     Разрешение приема. При установке этого бита в 1 разрешается работа  
                        приемника USART и переопределяется функционирование вывода RXD 
                        При сбросе бита RXEN0 работа приемника запрещается, а его буфер 
                        сбрасывается. Значения флагов ТХС0, DOR0 и FE0 при 
                        этом становятся недействительными 

           TXEN  -      Разрешение передачи. При установке этого бита в 1 разрешается работа  
                        передатчика UART и переопределяется функционирование вывода TXD. 
                        Если бит сбрасывается в 0 во время передачи, то выключение передатчика 
                        произойдет только после завершения передачи данных, находящихся в  
                        сдвиговом регистре и буфере передатчика 

            UCSZ2 -     Формат посылок. Этот бит совместно с битами UCSZ01:0 регистра UCSR0C 
                        используется для задания размера слов данных, передаваемых по 
                        последовательному каналу. 

            RXB8  -     8-й бит принимаемых данных. При использовании 9-битных слов данных этот 
                        бит содержит значение старшего бита принятого слова. Содержимое этого 
                        бита должно быть считано до прочтения регистра данных UDR0. 

            TXB8  -     8-й бит передаваемых данных. При использовании 9-битных слов данных  
                        содержимое этого бита является старшим битом передаваемого слова.  
                        Требуемое значение должно быть занесено в этот бит до загрузки байта данных в  
                        регистр UDR0 */
    UCSR0C = 1<<UCSZ00|1<<UCSZ01;
    /*
            Режим работы USART
            -----------------------------------  
            UMSEL  Режим работы USART
            -----------------------------------
               0     Асинхронный USART
               1     Синхронный USART
            -----------------------------------

            Режим работы схемы контроля и формирования бита четности. 
            -----------------------------------
            UPM1    UPM0    Режим работы схемы
            -----------------------------------
               0       0    Disabled
               0       1    Reserved
               1       0    Включена, проверка на четность  Even Parity
               1       1    Включена, проверка на нечетность  Odd Parity
            -----------------------------------

            Количество стоповых битов
            -----------------------------------
            USBS  Stop Bit(s)
             0      1-bit
             1      2-bit
            -----------------------------------

            Определение размера слова данных 
            -----------------------------------
            UCSZ2 UCSZ1 UCSZ0  Размер слова данных
            -----------------------------------
               0      0      0    5-bit
               0      0      1    6-bit
               0      1      0    7-bit
               0      1      1    8-bit
               1      0      0    Reserved
               1      0      1    Reserved
               1      1      0    Reserved
               1      1      1    9-bit
            -----------------------------------


            UCPOL - Полярность тактового сигнала. Значение этого бита определяет момент  
                             выдачи и считывания данных на выводах модуля. Бит используется только при 
                             работе в синхронном режиме. При работе в асинхронном режиме он должен 
                             быть сброшен в 0. 
            -------------------------------------------------------------------
            UCPOL  Выдача данных на вывод TXD  Считывание данных с вывода RXD
            -------------------------------------------------------------------
                    0    Спадающий фронт ХСК         Нарастающий фронт ХСК 
                    1    Нарастающий фронт ХСК       Спадающий фронт ХСК
            ------------------------------------------------------------------- */    
    RingBuffer_InitBuffer(&usartTxBuf, usartTxData, sizeof(usartTxData));
    RingBuffer_InitBuffer(&usartRxBuf, usartRxData, sizeof(usartRxData));
}

//______________________________________________________________________________


//помещает символ в буфер, инициирует начало передачи
BOOL USART_PutChar(u08 byte)
{
    if (RingBuffer_IsFull(&usartTxBuf)) // буфер полон
        return FALSE;
    RingBuffer_Insert(&usartTxBuf,byte);
    return TRUE; 
}
//функция посылающая байт по usart`у
void USART_SendByte(u08 byte)
{
    USART_PutChar(byte);
    UCSR0B|=(1<<UDRIE0); //включаем прерывания для передатчика
}
//функция посылающая строку по usart`у
void USART_SendStr(u08 *data)
{
    while(*data)
    {
        USART_PutChar(*data++);
    }
    UCSR0B|=(1<<UDRIE0); //включаем прерывания для передатчика
}
//функция посылающая число в строчном виде по usart`у
void USART_SendNum(s16 num)
{
    u16 temp;
    u08 str[6];
    u08 i = 0;
    if (num < 0)
        temp = -num;
    else
        temp = num;
    do 
    {
        str[i] = (temp % 10) | 0x30;
        temp = temp / 10;
        i++;
    } while (temp > 0);
    if (num < 0)
    {
        str[i] = '-';
        i++;
    }
    while (i > 0) 
    {
        i--; 
        USART_PutChar(str[i]);
    }
    UCSR0B|=(1<<UDRIE0); //включаем прерывания для передатчика
}

//обработчик прерывания по опустошению буфера передатчика
void USART_UDRE_Handler(void) 
{
    if (RingBuffer_IsEmpty(&usartTxBuf)) //если буфер не пустой
    {
        UCSR0B &=~(1<<UDRIE0); //Запрещаем прерывание по опустошению - передача закончена              
    } 
    else
    {
        UDR0 = RingBuffer_Remove(&usartTxBuf); //записываем в UDR символ из буфера
    }
} 

//______________________________________________________________________________
//возвращает колличество символов находящихся в приемном буфере


//чтение буфера
u08 USART_GetChar(void)
{
    u08 byte;
    if (RingBuffer_IsEmpty(&usartRxBuf)) // буфер пуст
        return 0;
    byte = RingBuffer_Remove(&usartRxBuf); //прочитать из него символ 
    return byte; 
}


//прерывание по завершению приема
void USART_RXC_Handler(void) 
{
    if (RingBuffer_IsFull(&usartRxBuf)) // буфер полон
        return; 
    u08 temp = UDR0;
    RingBuffer_Insert(&usartRxBuf,temp); //считать символ из UDR в буфер                                                                                                 
} 